## BSP/yocto/2022.09/meta_TySOM-M-MPFS250T_yocto_bsp/conf/layer.conf
```bitbake
# We have a conf and classes directory, add to BBPATH
BBPATH .= ":${LAYERDIR}"

# We have recipes-* directories, add to BBFILES
BBFILES += "${LAYERDIR}/recipes-*/*/*.bb ${LAYERDIR}/recipes-*/*/*.bbappend"

BBFILES_DYNAMIC += "\
    meta-TySOM-M-MPFS250T_yocto_bsp:${LAYERDIR}/dynamic-layers/meta-TySOM-M-MPFS250T_yocto_bsp/recipes-*/*/*.bbappend \
    meta-TySOM-M-MPFS250T_yocto_bsp:${LAYERDIR}/dynamic-layers/meta-TySOM-M-MPFS250T_yocto_bsp/recipes-*/*/*/*.bbappend \
"


BBFILE_COLLECTIONS += "meta_TySOM-M-MPFS250T_yocto_bsp"
BBFILE_PATTERN_meta_TySOM-M-MPFS250T_yocto_bsp = "^${LAYERDIR}/"
BBFILE_PRIORITY_meta_TySOM-M-MPFS250T_yocto_bsp = "1"

# This should only be incremented on significant changes that will
# cause compatibility issues with other layers
LAYERVERSION_meta_TySOM-M-MPFS250T_yocto_bsp = "1"

LAYERDEPENDS_meta_TySOM-M-MPFS250T_yocto_bsp = "core"
LAYERDEPENDS_meta_TySOM-M-MPFS250T_yocto_bsp += "riscv-layer"
LAYERDEPENDS_meta_TySOM-M-MPFS250T_yocto_bsp += "openembedded-layer"

LAYERSERIES_COMPAT_meta_TySOM-M-MPFS250T_yocto_bsp = "gatesgarth hardknott honister"
```

## BSP/yocto/2022.09/meta_TySOM-M-MPFS250T_yocto_bsp/conf/machine/tysom-m-mpfs250t-pcie.conf
```bitbake
#@TYPE: Machine
#@NAME: TySOM-M-MPFS250T
#@SOC: Polarfire SoC
#@DESCRIPTION: Machine support for TySOM-M-MPFS250T Evaluation Board.
#
# For details on the Evaluation board:
#     https://www.aldec.com/en/products/emulation/tysom_boards
#

require conf/machine/include/riscv/tune-riscv.inc

MACHINE_FEATURES = "screen keyboard ext2 ext3 serial"
MACHINE_TYPE = "smp"

KERNEL_CLASSES = "kernel-fitimage"
KERNEL_IMAGETYPE = "fitImage"
EXTERNAL_KERNEL_DEVICETREE = "${DEPLOY_DIR_IMAGE}/overlays"

RISCV_SBI_FDT ?=  "mpfs-tysom-m-pcie.dtb"
KERNEL_DTC_FLAGS += "-@"
KERNEL_DEVICETREE ?= "microchip/${RISCV_SBI_FDT}"
KBUILD_DEFCONFIG ?= "mpfs_defconfig"

PREFERRED_PROVIDER_virtual/kernel ?= "mpfs-linux"

PREFERRED_VERSION_openocd-native = "riscv"
PREFERRED_VERSION_openocd = "riscv"

PREFERRED_PROVIDER_virtual/bootloader = "u-boot-mpfs"

UBOOT_CONFIG = "aldec_tysom_m_mpfs250t"
UBOOT_CONFIG[aldec_tysom_m_mpfs250t] = "aldec_tysom_m_mpfs250t_defconfig"
UBOOT_CONFIG[aldec_tysom_m_mpfs250t_nor] = "aldec_tysom_m_mpfs250t_qspi_nor_defconfig"

INCLUDES += "${@bb.utils.contains('UBOOT_CONFIG', 'aldec_tysom_m_mpfs250t', \
' include/qspi-flash-nand.inc', ' include/qspi-flash-nor.inc', d)}"
require ${INCLUDES}

UBOOT_ENTRYPOINT = "0x80200000"
UBOOT_DTB_LOADADDRESS = "0x82200000"
UBOOT_DTBO_LOADADDRESS = "0x10 0x02300000"

UBOOT_ENV = "tftp-mmc"

HSS_PAYLOAD = "uboot"

MACHINE_EXTRA_RRECOMMENDS += " kernel-modules"

IMAGE_FSTYPES += "wic wic.gz wic.bmap ext4"
IMAGE_CLASSES:append = " image_type_mtd"

WIC_CREATE_EXTRA_ARGS ?= "--no-fstab-update"

WKS_FILE_DEPENDS ?= " \
    e2fsprogs-native \
    bmap-tools-native \
    u-boot-mpfs \
"

IMAGE_BOOT_FILES ?= " \
    fitImage \
    boot.scr.uimg \
"

WKS_FILE ?= "mpfs-rootfs.wks"
```

## BSP/yocto/2022.09/meta_TySOM-M-MPFS250T_yocto_bsp/conf/machine/tysom-m-mpfs250t.conf
```bitbake
#@TYPE: Machine
#@NAME: TySOM-M-MPFS250T
#@SOC: Polarfire SoC
#@DESCRIPTION: Machine support for TySOM-M-MPFS250T Evaluation Board.
#
# For details on the Evaluation board:
#     https://www.aldec.com/en/products/emulation/tysom_boards
#

require conf/machine/include/riscv/tune-riscv.inc

MACHINE_FEATURES = "screen keyboard ext2 ext3 serial"
MACHINE_TYPE = "smp"

KERNEL_CLASSES = "kernel-fitimage"
KERNEL_IMAGETYPE = "fitImage"
EXTERNAL_KERNEL_DEVICETREE = "${DEPLOY_DIR_IMAGE}/overlays"

RISCV_SBI_FDT ?=  "mpfs-tysom-m.dtb"
KERNEL_DTC_FLAGS += "-@"
KERNEL_DEVICETREE ?= "microchip/${RISCV_SBI_FDT}"
KBUILD_DEFCONFIG ?= "mpfs_defconfig"

PREFERRED_PROVIDER_virtual/kernel ?= "mpfs-linux"

PREFERRED_VERSION_openocd-native = "riscv"
PREFERRED_VERSION_openocd = "riscv"

PREFERRED_PROVIDER_virtual/bootloader = "u-boot-mpfs"

## Set this to "mpfs_icicle" to use a nand flash as the default external flash memory
## Set this to "mpfs_icicle_nor" to use a nor flash as the default external flash memory
## Note: If no external flash memory is found, U-boot will try to boot from SD/emmc 
## or fallback to tftp

UBOOT_CONFIG = "aldec_tysom_m_mpfs250t"
UBOOT_CONFIG[aldec_tysom_m_mpfs250t] = "aldec_tysom_m_mpfs250t_defconfig"
UBOOT_CONFIG[aldec_tysom_m_mpfs250t_nor] = "aldec_tysom_m_mpfs250t_qspi_nor_defconfig"

INCLUDES += "${@bb.utils.contains('UBOOT_CONFIG', 'aldec_tysom_m_mpfs250t', \
' include/qspi-flash-nand.inc', ' include/qspi-flash-nor.inc', d)}"
require ${INCLUDES}

UBOOT_ENTRYPOINT = "0x80200000"
UBOOT_DTB_LOADADDRESS = "0x82200000"
UBOOT_DTBO_LOADADDRESS = "0x10 0x02300000"

## Set this to "mmc-tftp" to generate a boot.scr file which should be included
##  in the boot partition. It will try to load a kernel image from mmc and fall back to tftp
UBOOT_ENV = "tftp-mmc"

HSS_PAYLOAD = "uboot"

MACHINE_EXTRA_RRECOMMENDS += " kernel-modules"

IMAGE_FSTYPES += "wic wic.gz wic.bmap ext4"
IMAGE_CLASSES:append = " image_type_mtd"

## Do not update fstab file when using wic images
WIC_CREATE_EXTRA_ARGS ?= "--no-fstab-update"

## wic default support
WKS_FILE_DEPENDS ?= " \
    e2fsprogs-native \
    bmap-tools-native \
    u-boot-mpfs \
"

IMAGE_BOOT_FILES ?= " \
    fitImage \
    boot.scr.uimg \
"

WKS_FILE ?= "mpfs-rootfs.wks"

CORE_IMAGE_EXTRA_INSTALL += " phytool board-tests can-sender can-listener canutils iproute2 devmem2 memtester python3-smbus2 can-fmc-loopback"
```
